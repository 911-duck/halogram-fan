#define NUM_LEDS 30
#define BRIGHTNESS 100
#define MOTOR_MAX 160
#define RES 2
#define COEF 0.3
#define PODGON 1.3
#define OFFSET 0
#define NUM_FRAMES 1
#define FRAME_RATE 1

#define PIN 4

#include <TimerOne.h>
#include "Adafruit_NeoPixel.h"
#include "gamma.h"

const uint16_t frame0[][15] PROGMEM = {
  { 0xAEDE, 0x763D, 0x64F6, 0x2265, 0x11C3, 0x438A, 0x1A24, 0x32A7, 0x0000, 0x0000, 0x0000, 0x0000, 0x0000, 0x0000, 0x0000 }, 
  { 0xBF1E, 0x763D, 0x6538, 0x2225, 0x1A44, 0x4389, 0x0901, 0x1163, 0x0000, 0x0000, 0x0000, 0x0000, 0x0000, 0x0000, 0x0000 }, 
  { 0xBF1E, 0x761D, 0x6538, 0x2205, 0x1A65, 0x2245, 0x2A25, 0x0000, 0x0000, 0x0000, 0x0000, 0x0000, 0x0000, 0x0000, 0x0000 }, 
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  { 0xAEDE, 0x763D, 0x64F6, 0x2265, 0x11C3, 0x438A, 0x1A24, 0x32A7, 0x0000, 0x0000, 0x0000, 0x0000, 0x0000, 0x0000, 0x0000 }, 
};

Adafruit_NeoPixel strip = Adafruit_NeoPixel(NUM_LEDS, PIN, NEO_GRB + NEO_KHZ800);

boolean motor_state = false;

volatile uint32_t timer;
volatile uint32_t period, new_period, period_f;
volatile boolean timer_isr, hall_isr, new_loop;

uint16_t counter1, counter2;
uint8_t counter;
const byte n_segm = 360 / RES;
const byte offset = 0;
byte this_frame = 0, count_frame;

static uint32_t expandColor(uint16_t color) {
  return ((uint32_t)pgm_read_byte(&gamma5[color >> 11]) << 16) | ((uint32_t)pgm_read_byte(&gamma6[(color >> 5) & 0x3F]) << 8) | pgm_read_byte(&gamma5[color & 0x1F]);
}

void setup() {
  Serial.begin(115200);
  strip.begin();
  strip.setBrightness(BRIGHTNESS);
  attachInterrupt(0, hall, RISING);
  Timer1.initialize();
  Timer1.stop();
  Timer1.attachInterrupt(timer_interrupt);
  strip.clear();
  strip.show();
}

void hall() {
  if (micros() - timer > 30000) {
    new_period = micros() - timer;
    timer = micros();
    hall_isr = true;
  }
}

void timer_interrupt() {
  timer_isr = true;
}

void setPix(byte i, int counter, int this_pix) {
  switch (this_frame) {
    case 0:
      strip.setPixelColor(i, expandColor(pgm_read_word(&(frame0[counter][this_pix]))));
      break;
      // case 1: strip.setPixelColor(i, expandColor(pgm_read_word(&(frame1[counter][this_pix]))));
      //   break;
      // case 2: strip.setPixelColor(i, expandColor(pgm_read_word(&(frame2[counter][this_pix]))));
      //   break;
      // case 3: strip.setPixelColor(i, expandColor(pgm_read_word(&(frame3[counter][this_pix]))));
      //   break;
      // case 4: strip.setPixelColor(i, expandColor(pgm_read_word(&(frame4[counter][this_pix]))));
      //   break;
      // case 5: strip.setPixelColor(i, expandColor(pgm_read_word(&(frame5[counter][this_pix]))));
      //   break;
      // case 6: strip.setPixelColor(i, expandColor(pgm_read_word(&(frame6[counter][this_pix]))));
      //   break;
      // case 7: strip.setPixelColor(i, expandColor(pgm_read_word(&(frame7[counter][this_pix]))));
      //   break;
      // case 8: strip.setPixelColor(i, expandColor(pgm_read_word(&(frame8[counter][this_pix]))));
      //   break;
  }
}

void animation() {
  timer_isr = false;
  strip.clear();

  byte this_pix = 0;
  for (int i = NUM_LEDS / 2 - 1; i >= 0; i--) {
    setPix(i, counter1, this_pix);
    this_pix++;
  }
  this_pix = 0;
  for (int i = NUM_LEDS / 2; i < NUM_LEDS; i++) {
    setPix(i, counter2, this_pix);
    this_pix++;
  }

  counter1++;
  counter2++;
  if (counter2 > n_segm) counter2 = 0;
  if (counter1 > n_segm) counter1 = 0;

  strip.show();
}

void loop() {
  if (hall_isr) {
    hall_isr = false;
    counter1 = 0 + offset;
    counter2 = n_segm / 2 + offset;
    if (counter2 > n_segm) counter2 = counter2 - n_segm;

    count_frame++;
    if (count_frame >= FRAME_RATE) {
      count_frame = 0;
      this_frame = ++this_frame % NUM_FRAMES;
    }

    animation();
    period_f = (float)new_period * COEF + (float)period_f * ((float)1 - COEF);
    Timer1.setPeriod(period_f / n_segm * PODGON);
    Timer1.restart();
  }

  if (timer_isr) {
    timer_isr = false;
    animation();
  }
}